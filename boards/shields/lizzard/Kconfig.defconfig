## boards/shields/lizzard/Kconfig.defconfig
```kconfig
if SHIELD_LIZZARD_LEFT

# Name must be less than 16 characters long!
config ZMK_KEYBOARD_NAME
    default "lizzard"

config ZMK_SPLIT_ROLE_CENTRAL
    default y

config ZMK_SPLIT_BLE_CENTRAL_PERIPHERALS
  default 1

config BT_MAX_CONN
  default 6

config BT_MAX_PAIRED
  default 6

endif

if SHIELD_LIZZARD_LEFT || SHIELD_LIZZARD_RIGHT

config ZMK_SPLIT
    default y

config ZMK_POINTING
    default y

endif

# ---------------------
# Kconfig for shield "lizzard_left" with board "nice_nano_v2"
# ---------------------
if BOARD_NICE_NANO_V2 && SHIELD_LIZZARD_LEFT

config SPI
    default y

endif

# ---------------------
# Kconfig for shield "lizzard_right" with board "nice_nano_v2"
# ---------------------
if BOARD_NICE_NANO_V2 && SHIELD_LIZZARD_RIGHT

config I2C
    default y

endif
```

## boards/shields/lizzard/Kconfig.shield
```kconfig
config SHIELD_LIZZARD_LEFT
    def_bool $(shields_list_contains,lizzard_left)
  
config SHIELD_LIZZARD_RIGHT
    def_bool $(shields_list_contains,lizzard_right)
  
```
